## firmware/br-external/Config.in
```kconfig
source "$BR2_EXTERNAL_PLUTO_NANO_PATH/package/soapysdr/Config.in"
source "$BR2_EXTERNAL_PLUTO_NANO_PATH/package/soapyplutosdr-ts/Config.in"
source "$BR2_EXTERNAL_PLUTO_NANO_PATH/package/sdr-ip-gadget/Config.in"
```

## firmware/br-external/package/aic8800d80/Config.in
```kconfig
config BR2_PACKAGE_AIC8800D80
	bool "aic8800d80 (AICSemi AIC8800D80 USB Wi-Fi 6 driver + firmware)"
	depends on BR2_LINUX_KERNEL
	help
	  Out-of-tree kernel modules aic_load_fw and aic8800_fdrv for the
	  AIC8800D80 USB Wi-Fi adapter (community fork shenmintao/aic8800d80),
	  plus the firmware blobs installed to /lib/firmware/aic8800D80.

	  https://github.com/shenmintao/aic8800d80
```

## firmware/br-external/package/sdr-ip-gadget/Config.in
```kconfig
config BR2_PACKAGE_SDR_IP_GADGET
	bool "sdr-ip-gadget"
	select BR2_PACKAGE_LIBIIO
	help
	  pgreenland's IP streaming daemon: IIO buffers (with the
	  FPGA sample timestamps) over UDP, control port 30432, data
	  port 30433. SoapyPlutoSDR uri=ip:<addr>,direct=1 talks to
	  it, including uri=ip:127.0.0.1 from an application on the
	  Pluto itself.

	  https://github.com/pgreenland/pluto-sdr-ip-gadget
```

## firmware/br-external/package/soapyplutosdr-ts/Config.in
```kconfig
config BR2_PACKAGE_SOAPYPLUTOSDR_TS
	bool "soapyplutosdr-ts"
	depends on BR2_PACKAGE_SOAPYSDR
	select BR2_PACKAGE_LIBIIO
	select BR2_PACKAGE_LIBAD9361_IIO
	select BR2_PACKAGE_LIBUSB
	help
	  SoapyPlutoSDR with pgreenland's sample timestamping
	  (sdr_gadget_timestamping, direct=1 over the USB and IP
	  gadgets), for applications that run on the Pluto itself.

	  https://github.com/pgreenland/SoapyPlutoSDR
```

## firmware/br-external/package/soapysdr/Config.in
```kconfig
config BR2_PACKAGE_SOAPYSDR
	bool "soapysdr"
	depends on BR2_INSTALL_LIBSTDCPP
	depends on BR2_TOOLCHAIN_HAS_THREADS
	help
	  SoapySDR vendor-neutral SDR API (library + SoapySDRUtil).
	  Device modules are loaded with dlopen from
	  /usr/lib/SoapySDR/modules0.8.

	  https://github.com/pothosware/SoapySDR
```

## rtos/image/rtos.its
```
/*
 * Nexus-BS RTOS image for the Pluto Nano: PL bitstream + RTEMS kernel, booted by the Tezuka
 * U-Boot with `bootm ${fit_load_address}` (from QSPI or after `run dfu_ram`).
 */
/dts-v1/;
/ {
	description = "Nexus-BS RTOS (RTEMS) for Pluto Nano";
	#address-cells = <1>;
	images {
		fpga@1 {
			description = "FPGA";
			data = /incbin/("system_top.bit");
			type = "fpga";
			arch = "arm";
			compression = "none";
			load = <0xF000000>;
			hash@1 { algo = "md5"; };
		};
		rtems@1 {
			description = "Nexus-BS RTOS";
			data = /incbin/("nexus-rtos.bin");
			type = "kernel";
			arch = "arm";
			os = "rtems";
			compression = "none";
			load = <0x00100000>;
			entry = <0x00100000>;
			hash@1 { algo = "md5"; };
		};
	};
	configurations {
		default = "config@0";
		config@0 {
			description = "Nexus-BS RTOS";
			kernel = "rtems@1";
			loadables = "fpga@1";
		};
	};
};
```
